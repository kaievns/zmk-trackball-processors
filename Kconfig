## Kconfig
```kconfig
config ZMK_INPUT_PROCESSOR_SPIKE_FILTER
	bool "Acceleration-based spike filter"
	default y if DT_HAS_ZMK_INPUT_PROCESSOR_SPIKE_FILTER_ENABLED
	help
	  Filters stiction spikes by detecting sudden acceleration
	  between consecutive samples.

config ZMK_INPUT_PROCESSOR_RESPONSE_CURVE
	bool "Response curve input processor"
	default y if DT_HAS_ZMK_INPUT_PROCESSOR_RESPONSE_CURVE_ENABLED
	help
	  Controller-style power curve that compresses small movements
	  while preserving large ones.
```

## modules/behaviors/Kconfig
```kconfig
config ZMK_INPUT_PROCESSOR_SPIKE_FILTER
	bool "Acceleration-based spike filter"
	default y if DT_HAS_ZMK_INPUT_PROCESSOR_SPIKE_FILTER_ENABLED
	help
	  Filters stiction spikes by detecting sudden acceleration
	  between consecutive samples.

config ZMK_INPUT_PROCESSOR_RESPONSE_CURVE
	bool "Response curve input processor"
	default y if DT_HAS_ZMK_INPUT_PROCESSOR_RESPONSE_CURVE_ENABLED
	help
	  Controller-style power curve that compresses small movements
	  while preserving large ones.

config ZMK_INPUT_PROCESSOR_MOUSE_LAYER
	bool "Mouse layer input processor with click/drag/double-click awareness"
	default y if DT_HAS_ZMK_INPUT_PROCESSOR_MOUSE_LAYER_ENABLED
	depends on !ZMK_SPLIT || ZMK_SPLIT_ROLE_CENTRAL
	help
	  Temporarily activates a mouse layer on trackball movement.
	  Handles drag hold, double-click linger, and idle timeout.
```

## modules/behaviors/dts/bindings/zmk,input-processor-accel.yaml
```yaml
# Acceleration power curve input processor
#
# Applies d^(param1/100) acceleration to relative X/Y input events.
# param1 = exponent x100 (100=linear, 120=MX Ergo-like, 140=moderate)
#
# Usage:
#   input-processors = <&zip_accel 120>;

description: Input processor that applies a power-curve acceleration to pointer motion.

compatible: "zmk,input-processor-accel"

include: ip_one_param.yaml

properties: {}
```

## modules/behaviors/dts/bindings/zmk,input-processor-deflicker.yaml
```yaml
# Deflicker input processor — suppresses trackball breakaway jerk
#
# param1 = ramp-up length in samples (1-8)
#   1 = minimal, 3 = recommended, 6 = aggressive
#
# Usage:
#   input-processors = <&zip_deflicker 3>;

description: Input processor that dampens initial movement spikes after idle gaps.

compatible: "zmk,input-processor-deflicker"

include: ip_one_param.yaml

properties: {}
```

## modules/behaviors/dts/bindings/zmk,input-processor-mouse-layer.yaml
```yaml
# Mouse layer input processor
#
# Activates a layer on trackball movement with smart click/drag/double-click
# handling. Deactivates after idle timeout or double-click completion.
#
# param1 = target layer
# param2 = idle timeout (ms)
#
# Usage:
#   input-processors = <&zip_mouse_layer 8 500>;

description: Input processor that temporarily activates a mouse layer with click-aware lifecycle.

compatible: "zmk,input-processor-mouse-layer"

include: ip_two_param.yaml

properties:
  require-prior-idle-ms:
    type: int
    required: false
    default: 0
    description: >
      Minimum milliseconds since last keystroke before trackball
      movement can activate the layer. Prevents accidental activation
      while typing.

  activation-threshold:
    type: int
    required: false
    default: 0
    description: >
      Minimum cumulative movement (|dx| + |dy|) required before the
      layer activates from IDLE. Small values filter out trackball
      jitter during typing. The accumulator resets when the layer
      activates, after the require-prior-idle window expires, or
      after a short movement-idle timeout.

  activation-window-ms:
    type: int
    required: false
    default: 200
    description: >
      Maximum time window over which activation-threshold movement
      must accumulate. If no movement arrives within this window,
      the accumulator resets to zero.

  double-click-window-ms:
    type: int
    required: false
    default: 300
    description: >
      After a mouse click, the layer lingers for this many milliseconds
      to allow a double-click. A second click within this window completes
      the double-click and then deactivates the layer.

  active-layers:
    type: array
    required: false
    default: []
    description: >
      Layer indices where the processor is allowed to activate. If
      empty (default), the processor activates from any layer. If
      set, trackball movement only triggers the mouse layer when one
      of the listed layers is currently the highest active layer.

  button-positions:
    type: array
    required: false
    default: []
    description: >
      Key positions that are treated as mouse buttons. Pressing these
      positions triggers drag-hold and double-click logic. Typically
      the positions where mkp bindings live on the target layer.
```

## modules/behaviors/dts/bindings/zmk,input-processor-response-curve.yaml
```yaml
# Response curve input processor — controller-style sensitivity curve
#
# param1 = curve intensity (0-10)
#   0 = linear, 3 = mild, 5 = moderate, 10 = heavy
#
# Usage:
#   input-processors = <&zip_response_curve 5>;

description: Power-curve response mapping that compresses small movements.

compatible: "zmk,input-processor-response-curve"

include: ip_one_param.yaml

properties: {}
```

## modules/behaviors/dts/bindings/zmk,input-processor-smooth.yaml
```yaml
# Moving average smoothing input processor
#
# param1 = window size (samples to average)
#   1 = off, 2 = light, 3 = moderate, 4+ = heavy (max 8)
#
# Usage:
#   input-processors = <&zip_smooth 3>;

description: Moving average low-pass filter for pointer smoothing.

compatible: "zmk,input-processor-smooth"

include: ip_one_param.yaml

properties: {}
```

## modules/behaviors/dts/bindings/zmk,input-processor-spike-filter.yaml
```yaml
# Acceleration-based spike filter
#
# param1 = sensitivity (1-10)
#   1 = tolerant, 5 = moderate, 10 = aggressive
#
# Usage:
#   input-processors = <&zip_spike_filter 5>;

description: Filters stiction spikes by detecting sudden acceleration.

compatible: "zmk,input-processor-spike-filter"

include: ip_one_param.yaml

properties: {}
```

## modules/behaviors/dts/bindings/zmk,trackball-dpi-profiles.yaml
```yaml
description: |
  Layer-based trackball DPI switcher.

  Set a default DPI on the node itself. Add child nodes to override
  DPI for specific layers. Unmatched layers use the default.

    trackball_dpi {
        compatible = "zmk,trackball-dpi-profiles";
        dpi = <600>;        // default for all layers

        scroll {
            layers = <9>;   // override for scroll layer
            dpi = <400>;
        };
    };

compatible: "zmk,trackball-dpi-profiles"

properties:
  dpi:
    type: int
    required: true
    description: Default sensor CPI (200-3200, multiple of 200).

child-binding:
  description: Layer-specific DPI override.
  properties:
    layers:
      type: array
      required: true
      description: Layer indices this override applies to.

    dpi:
      type: int
      required: true
      description: Sensor CPI for these layers.
```

## modules/behaviors/dts/bindings/zmk,trackball-profiles.yaml
```yaml
description: |
  Layer-based trackball DPI / acceleration profiles.

  Each child node defines a profile with a list of layers it applies to.
  When the active layer changes, the matching profile is activated.
  If multiple profiles match, the one whose layer has the highest index wins.
  If no profile matches the current layer, the first profile is used as default.

compatible: "zmk,trackball-profiles"

child-binding:
  description: A single trackball profile.
  properties:
    layers:
      type: array
      required: true
      description: |
        List of layer indices this profile applies to.
        Example: layers = <0 1 2>; applies to layers 0, 1, and 2.

    dpi:
      type: int
      required: true
      description: Sensor CPI (200-3200, multiple of 200).

    acceleration-exponent:
      type: int
      required: true
      description: |
        Power curve exponent, fixed-point x100.
        100 = linear (no acceleration)
        120 = smooth, mild (MX Ergo-like)
        140 = moderate
        200 = aggressive
```
